## conf/layer.conf
```bitbake
# We have a conf and classes directory, add to BBPATH
BBPATH .= ":${LAYERDIR}"

# We have recipes-* directories, add to BBFILES
BBFILES += "${LAYERDIR}/recipes-*/*/*.bb ${LAYERDIR}/recipes-*/*/*.bbappend"

BBFILE_COLLECTIONS += "zf"
BBFILE_PATTERN_zf = "^${LAYERDIR}/"
BBFILE_PRIORITY_zf = "11"

# This should only be incremented on significant changes that will
# cause compatibility issues with other layers
LAYERVERSION_zf = "1"

LAYERDEPENDS_zf = "core nmrouter"
```
